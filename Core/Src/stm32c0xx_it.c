/* USER CODE BEGIN Header */
/**
  ******************************************************************************
  * @file    stm32c0xx_it.c
  * @brief   Interrupt Service Routines.
  ******************************************************************************
  * @attention
  *
  * Copyright (c) 2024 STMicroelectronics.
  * All rights reserved.
  *
  * This software is licensed under terms that can be found in the LICENSE file
  * in the root directory of this software component.
  * If no LICENSE file comes with this software, it is provided AS-IS.
  *
  ******************************************************************************
  */
/* USER CODE END Header */

/* Includes ------------------------------------------------------------------*/
#include "main.h"
#include "stm32c0xx_it.h"
/* Private includes ----------------------------------------------------------*/
/* USER CODE BEGIN Includes */
/* USER CODE END Includes */

/* Private typedef -----------------------------------------------------------*/
/* USER CODE BEGIN TD */

/* USER CODE END TD */

/* Private define ------------------------------------------------------------*/
/* USER CODE BEGIN PD */
 	 struct fadeFunctionValues {
 		 uint16_t indx; // will be used in program
 		 uint16_t length; // this needs to be the size of your sequence (see next)
 		 uint16_t brightness[512]; // here a sequence of brightnesses is stored 1 step = 10 ms
 	 };
/* USER CODE END PD */

/* Private macro -------------------------------------------------------------*/
/* USER CODE BEGIN PM */

/* USER CODE END PM */

/* Private variables ---------------------------------------------------------*/
/* USER CODE BEGIN PV */
	// uint8_t updown=1; // for DEBUG
	struct fadeFunctionValues outputA = { // this are settings for LED 1 and 2
			.indx = 0,
			//.length = 10,  // EXAMPLE
			//.brightness = {0x000,0x000,0x000,0x000,0x000,0x3FF,0x3FF,0x3FF,0x3FF,0x3FF} // EXAPMLE
			.length = 213, // 234 mHz = 4.274 s
			.brightness = {0x033, 0x033, 0x033, 0x034, 0x036, 0x038, 0x03a, 0x03d, 0x040, 0x043, 0x047, 0x04b, 0x04f,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 0x033, 0x033}

	};
	struct fadeFunctionValues outputB = { // this are settings for LED 3 and 4
			.indx = 0,
			.length = 144, // 345 mHz = 2.899 s
			.brightness = {0x033, 0x033, 0x034, 0x037, 0x03a, 0x03e, 0x043, 0x048, 0x04f, 0x056, 0x05e, 0x067, 0x071,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 0x033, 0x033}
	};
	struct fadeFunctionValues outputC = { // this are settings for LED 5 and 6
			.indx = 0,
			.length = 109, // 456 mHz = 2.193 s
			.brightness = {0x033, 0x033, 0x036, 0x03a, 0x03f, 0x046, 0x04e, 0x058, 0x064, 0x070, 0x07e, 0x08e, 0x09e,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 0x033, 0x033}
	};
	struct fadeFunctionValues outputD = { // this are settings for LED 7 and 8
			.indx = 0,
			.length = 406, // 123 mHz = 8.130 s
			.brightness = {0x033, 0x033, 0x033, 0x033, 0x034, 0x034, 0x035, 0x035, 0x036, 0x037, 0x038, 0x039, 0x03b,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 0x033, 0x033}
	};
/* USER CODE END PV */

/* Private function prototypes -----------------------------------------------*/
/* USER CODE BEGIN PFP */

/* USER CODE END PFP */

/* Private user code ---------------------------------------------------------*/
/* USER CODE BEGIN 0 */

/* USER CODE END 0 */

/* External variables --------------------------------------------------------*/
extern TIM_HandleTypeDef htim3;
/* USER CODE BEGIN EV */

/* USER CODE END EV */

/******************************************************************************/
/*           Cortex Processor Interruption and Exception Handlers          */
/******************************************************************************/
/**
  * @brief This function handles Non maskable interrupt.
  */
void NMI_Handler(void)
{
  /* USER CODE BEGIN NonMaskableInt_IRQn 0 */

  /* USER CODE END NonMaskableInt_IRQn 0 */
  /* USER CODE BEGIN NonMaskableInt_IRQn 1 */
   while (1)
  {
  }
  /* USER CODE END NonMaskableInt_IRQn 1 */
}

/**
  * @brief This function handles Hard fault interrupt.
  */
void HardFault_Handler(void)
{
  /* USER CODE BEGIN HardFault_IRQn 0 */

  /* USER CODE END HardFault_IRQn 0 */
  while (1)
  {
    /* USER CODE BEGIN W1_HardFault_IRQn 0 */
    /* USER CODE END W1_HardFault_IRQn 0 */
  }
}

/**
  * @brief This function handles System service call via SWI instruction.
  */
void SVC_Handler(void)
{
  /* USER CODE BEGIN SVC_IRQn 0 */

  /* USER CODE END SVC_IRQn 0 */
  /* USER CODE BEGIN SVC_IRQn 1 */

  /* USER CODE END SVC_IRQn 1 */
}

/**
  * @brief This function handles Pendable request for system service.
  */
void PendSV_Handler(void)
{
  /* USER CODE BEGIN PendSV_IRQn 0 */

  /* USER CODE END PendSV_IRQn 0 */
  /* USER CODE BEGIN PendSV_IRQn 1 */

  /* USER CODE END PendSV_IRQn 1 */
}

/**
  * @brief This function handles System tick timer.
  */
void SysTick_Handler(void)
{
  /* USER CODE BEGIN SysTick_IRQn 0 */

  /* USER CODE END SysTick_IRQn 0 */
  HAL_IncTick();
  /* USER CODE BEGIN SysTick_IRQn 1 */

  /* USER CODE END SysTick_IRQn 1 */
}

/******************************************************************************/
/* STM32C0xx Peripheral Interrupt Handlers                                    */
/* Add here the Interrupt Handlers for the used peripherals.                  */
/* For the available peripheral interrupt handler names,                      */
/* please refer to the startup file (startup_stm32c0xx.s).                    */
/******************************************************************************/

/**
  * @brief This function handles TIM3 global interrupt.
  */
void TIM3_IRQHandler(void)
{
  /* USER CODE BEGIN TIM3_IRQn 0 */
	// IMPORTANT!!! Use 'HAL_TIM_Base_Start_IT(&htim3);' in 'main.c' !!!
	TIM1->CCR1 = outputA.brightness[outputA.indx]; // set brightness for LEDs 1 and 2
	outputA.indx++; // increase for next value in LED brightness sequence
	if (outputA.indx >= outputA.length) // if end of sequence of LED brightnesses is reached, reset index
	{
		outputA.indx = 0;
	}
	//************************************************************************
	sftwrBrightness = outputB.brightness[outputB.indx]; // set brightness for LEDs 3 and 4
	outputB.indx++; // increase for next value in LED brightness sequence
	if (outputB.indx >= outputB.length) // if end of sequence of LED brightnesses is reached, reset index
	{
		outputB.indx = 0;
	}
	//************************************************************************
	TIM1->CCR4 = outputC.brightness[outputC.indx]; // set brightness for LEDs 5 and 6
	outputC.indx++; // increase for next value in LED brightness sequence
	if (outputC.indx >= outputC.length) // if end of sequence of LED brightnesses is reached, reset index
	{
		outputC.indx = 0;
	}
	//************************************************************************
	TIM1->CCR2 = outputD.brightness[outputD.indx]; // set brightness for LEDs 7 and 8
	outputD.indx++; // increase for next value in LED brightness sequence
	if (outputD.indx >= outputD.length) // if end of sequence of LED brightnesses is reached, reset index
	{
		outputD.indx = 0;
	}
	//************************************************************************
	//************************************************************************
	//************************************************************************
	// FOLLOWING: For DEBUG
	// if (updown == 1)
	// {
	// 	if (sftwrBrightness <= 1023)
	// 	{
	// 		sftwrBrightness = sftwrBrightness + 10;
	// 	}
	// 	else
	// 	{
	// 		updown = 0;
	// 	}
	// }
	//
	// if (updown == 0)
	// {
	// 	if (sftwrBrightness > 0)
	// 	{
	// 		sftwrBrightness = sftwrBrightness - 10;
	// 	}
	// 	else
	// 	{
	// 		updown = 1;
	// 	}
	// }
  /* USER CODE END TIM3_IRQn 0 */
  HAL_TIM_IRQHandler(&htim3);
  /* USER CODE BEGIN TIM3_IRQn 1 */

  /* USER CODE END TIM3_IRQn 1 */
}

/* USER CODE BEGIN 1 */

/* USER CODE END 1 */
